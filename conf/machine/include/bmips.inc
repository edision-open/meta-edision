## conf/machine/include/bmips.inc
```bitbake
TARGET_ARCH = "mipsel"
DEFAULTTUNE = "mips32el"

require conf/machine/include/tune-mips32.inc

BOX_BRAND = "edision"

MACHINE_FEATURES += "HDMI"

KERNEL_FILE = "kernel.bin"
ROOTFS_FILE = "rootfs.bin"

STB_PLATFORM = "edisionmips"
```

## conf/machine/include/brahma-b53.inc
```bitbake
# arm
DEFAULTTUNE = "armv7vehf-neon-vfpv4"
KERNEL_IMAGETYPE = "zImage"

## arm64
#DEFAULTTUNE = "aarch64"
#KERNEL_IMAGETYPE = "Image.gz"

require conf/machine/include/arm/arch-arm64.inc

BOX_BRAND = "edision"

SOC_FAMILY = "bcm72604"

MTD_BOOTFS = "mmcblk1p1"
MTD_BLACK  = "mmcblk1"
MTD_KERNEL = "mmcblk1p2"
MTD_ROOTFS = "mmcblk1p3"
KERNEL_FILE = "kernel.bin"
ROOTFS_FILE = "rootfs.tar.bz2"

MACHINE_FEATURES += "HDMI"

STB_PLATFORM = "edision4k"

RCNAME = "edision3"
```

## conf/machine/include/edision-arm64-common.inc
```bitbake
#
# Common configuration for all machines of the arm64 type
#

# arm
DEFAULTTUNE = "armv7vehf-neon-vfpv4"
KERNEL_IMAGETYPE = "zImage"
require conf/machine/include/arm/arch-arm64.inc

## arm64
#DEFAULTTUNE = "aarch64"
#KERNEL_IMAGETYPE = "Image.gz"
#require conf/machine/include/arm/arch-armv8a.inc
```

## conf/machine/include/edision-mips-common.inc
```bitbake
#
# Common configuration for all machines of the mips type
#

TARGET_ARCH = "mipsel"
DEFAULTTUNE = "mips32el"
require conf/machine/include/tune-mips32.inc
```

## conf/machine/include/meta-edision.inc
```bitbake
#
# BSP variables and settings specific to the meta-edision layer
#

# We know about rtc
MACHINE_FEATURES_BACKFILL_CONSIDERED = "rtc"

# recommended extra packages common to all edision machines
MACHINE_ESSENTIAL_EXTRA_RRECOMMENDS_append = " kernel-module-rt2800usb"
MACHINE_EXTRA_RRECOMMENDS_append = " gst-plugin-dvbmediasink"
MACHINE_EXTRA_RRECOMMENDS_append = " enigma2-plugin-drivers-dvb-usb-opticombo"
MACHINE_EXTRA_RRECOMMENDS_append = " edision-splash"

# common machine features
MACHINE_FEATURES_append = " alsa wlan 3dtv switchoff osdposition hdmicec videoenhancement"
```

## conf/machine/include/os.inc
```bitbake
# We know about rtc
MACHINE_FEATURES_BACKFILL_CONSIDERED = "rtc"

MACHINE_ESSENTIAL_EXTRA_RDEPENDS = " \
	os-dvb-modules-${MACHINE} \
	"

MACHINE_ESSENTIAL_EXTRA_RRECOMMENDS = " \
	kernel-module-cdfs \
	"

KERNEL_MODULE_AUTOLOAD += "xfs"

MACHINE_EXTRA_RRECOMMENDS = " \
	gst-plugin-dvbmediasink \
	"

DVBMEDIASINK_CONFIG = "--with-wma --with-wmv --with-pcm --with-dts --with-eac3"

PREFERRED_PROVIDER_virtual/kernel = "linux-os"
PREFERRED_PROVIDER_virtual/blindscan-dvbs = "os-blindscan-utils"
PREFERRED_PROVIDER_virtual/blindscan-dvbc = "os-blindscan-utils"

KERNEL_IMAGETYPE = "vmlinux"
KERNEL_OUTPUT = "${KERNEL_IMAGETYPE}"
KERNEL_CONSOLE = "ttyS0,115200n8"

IMAGE_FSTYPES ?= "ubi"

UBI_VOLNAME = "rootfs"
MKUBIFS_ARGS = "-m 2048 -e 126976 -c 4096 -F"
UBINIZE_ARGS = "-m 2048 -p 128KiB"

IMAGEDIR ?= "${MACHINE}"

IMAGE_CMD_ubi_append = " \
	mkdir -p ${DEPLOY_DIR_IMAGE}/${IMAGEDIR}; \
	cp ${DEPLOY_DIR_IMAGE}/${IMAGE_NAME}.rootfs.ubi ${DEPLOY_DIR_IMAGE}/${IMAGEDIR}/rootfs.bin; \
	gzip -9c ${DEPLOY_DIR_IMAGE}/vmlinux-${MACHINE}.bin > ${DEPLOY_DIR_IMAGE}/${IMAGEDIR}/kernel.bin; \
	echo ${DISTRO_NAME}-${DISTRO_VERSION}-${DATE} > ${DEPLOY_DIR_IMAGE}/${IMAGEDIR}/imageversion; \
	echo "rename this file to 'force' to force an update without confirmation" > ${DEPLOY_DIR_IMAGE}/${IMAGEDIR}/noforce; \
	cd ${DEPLOY_DIR_IMAGE}; \
	zip ${DISTRO_NAME}-${DISTRO_VERSION}-${MACHINE}_usb.zip ${IMAGEDIR}/*; \
	rm -Rf ${IMAGEDIR}; \
	"
IMAGE_CMD_ubi_prepend = " \
	rm -Rf ${IMAGE_ROOTFS}/boot/*; \
        rm -Rf ${IMAGE_ROOTFS}/tmp/*; \
        "

MACHINE_FEATURES += "alsa wlan 3dtv switchoff osdposition hdmicec"
```

## conf/machine/include/rootfs-emmc.inc
```bitbake
IMAGE_CLASSES += "osmio4k-emmcimg"
IMAGE_FSTYPES ?= "emmcimg tar.bz2"
IMAGE_OVERHEAD_FACTOR = "1.0"

IMAGEDIR ?= "${MACHINE}"
IMGDEPLOYDIR ?= "${DEPLOY_DIR_IMAGE}"
IMAGEVERSION := "${DISTRO_NAME}-${DISTRO_VERSION}-${DATE}"
IMAGEVERSION[vardepsexclude] = "DATE"

IMAGE_CMD_emmcimg_append = "\
    mkdir -p ${IMGDEPLOYDIR}/${IMAGEDIR}; \
    cp -f ${IMGDEPLOYDIR}/${IMAGE_NAME}.rootfs.emmc ${IMGDEPLOYDIR}/${IMAGEDIR}/emmc.img; \
    cp -f ${DEPLOY_DIR_IMAGE}/${KERNEL_IMAGETYPE}-${MACHINE}.bin ${IMGDEPLOYDIR}/${IMAGEDIR}/kernel.bin; \
    cp -f ${IMGDEPLOYDIR}/${IMAGE_NAME}.rootfs.tar.bz2 ${IMGDEPLOYDIR}/${IMAGEDIR}/rootfs.tar.bz2; \
    cp -f ${DEPLOY_DIR_IMAGE}/splash.bin ${IMGDEPLOYDIR}/${IMAGEDIR}; \
    echo "${IMAGEVERSION}" > ${IMGDEPLOYDIR}/${IMAGEDIR}/imageversion; \
    echo "rename this file to 'force' to force an update without confirmation" > ${IMGDEPLOYDIR}/${IMAGEDIR}/noforce; \
    cd ${IMGDEPLOYDIR}; \
    zip ${DISTRO_NAME}-${DISTRO_VERSION}-${MACHINE}_usb.zip ${IMAGEDIR}/emmc.img ${IMAGEDIR}/imageversion ${IMAGEDIR}/noforce ${IMAGEDIR}/splash.bin ; \
    zip ${DISTRO_NAME}-${DISTRO_VERSION}-${MACHINE}_multiboot_ofgwrite.zip ${IMAGEDIR}/imageversion ${IMAGEDIR}/kernel.bin ${IMAGEDIR}/rootfs.tar.bz2; \
    rm -rf ${IMAGEDIR}; \
    "
```

## conf/machine/include/rootfs-ubi.inc
```bitbake
IMAGE_FSTYPES ?= "ubi"
UBI_VOLNAME = "rootfs"
MKUBIFS_ARGS = "-m 2048 -e 126976 -c 4096 -F"
UBINIZE_ARGS = "-m 2048 -p 128KiB"

IMAGEDIR ?= "${MACHINE}"
IMGDEPLOYDIR ?= "${DEPLOY_DIR_IMAGE}"
IMAGEVERSION := "${DISTRO_NAME}-${DISTRO_VERSION}-${DATE}"
IMAGEVERSION[vardepsexclude] = "DATE"

IMAGE_CMD_ubi_prepend = " \
	rm -rf ${IMAGE_ROOTFS}/boot/*; \
	rm -rf ${IMAGE_ROOTFS}/tmp/*; \
	"

IMAGE_CMD_ubi_append = " \
	mkdir -p ${IMGDEPLOYDIR}/${IMAGEDIR}; \
	cp -f ${IMGDEPLOYDIR}/${IMAGE_NAME}.rootfs.ubi ${IMGDEPLOYDIR}/${IMAGEDIR}/rootfs.bin; \
	cp -f ${DEPLOY_DIR_IMAGE}/${KERNEL_IMAGETYPE}-${MACHINE}.bin ${IMGDEPLOYDIR}/${IMAGEDIR}/kernel.bin; \
	cp -f ${DEPLOY_DIR_IMAGE}/splash.bin ${IMGDEPLOYDIR}/${IMAGEDIR}; \
	echo "${IMAGEVERSION}" > ${IMGDEPLOYDIR}/${IMAGEDIR}/imageversion; \
	echo "rename this file to 'force' to force an update without confirmation" > ${IMGDEPLOYDIR}/${IMAGEDIR}/noforce; \
	cd ${IMGDEPLOYDIR}; \
	zip ${DISTRO_NAME}-${DISTRO_VERSION}-${MACHINE}_usb.zip ${IMAGEDIR}/*; \
	rm -rf ${IMAGEDIR}; \
	"
```

## conf/machine/osmega.conf
```bitbake
#@TYPE: Machine
#@NAME: Edision OS mega
#@DESCRIPTION: Machine configuration for the Edision OS mega

CHIPSET = "bcm73565"

require conf/machine/include/meta-edision.inc
require conf/machine/include/edision-mips-common.inc
require conf/machine/include/edision-rootfs-ubi.inc

MACHINE_ESSENTIAL_EXTRA_RDEPENDS_append = " os-dvb-modules-${MACHINE}"
MACHINE_ESSENTIAL_EXTRA_RRECOMMENDS_append = " kernel-module-r8723bs firmware-rtl8723bs"
MACHINE_ESSENTIAL_EXTRA_RRECOMMENDS_append = " kernel-module-hci-uart"

MACHINE_ESSENTIAL_EXTRA_RRECOMMENDS += " \
    kernel-module-cdfs \
    "

DVBMEDIASINK_CONFIG = "--with-wma --with-wmv --with-pcm --with-dts --with-eac3 --with-h265 --with-vb6 --with-vb8 --with-vb9 --with-spark"

PREFERRED_PROVIDER_virtual/blindscan-dvbs = "os-blindscan-utils"
PREFERRED_PROVIDER_virtual/blindscan-dvbc = "os-blindscan-utils"
PREFERRED_PROVIDER_virtual/kernel = "linux-os"
PREFERRED_VERSION_linux-os = "4.11"
PREFERRED_PROVIDER_virtual/egl = "v3d-libgles-${MACHINE}"
PREFERRED_PROVIDER_virtual/libgles2 = "v3d-libgles-${MACHINE}"

MTD_KERNEL = "mtd0"
KERNEL_IMAGETYPE = "vmlinux.gz"
KERNEL_CONSOLE = "ttyS0,115200n8"

KERNEL_MODULE_AUTOLOAD_append = " r8723bs"
KERNEL_MODULE_AUTOLOAD_append = " hci_uart"

MACHINE_FEATURES_append += " textlcd dvb-c blindscan-dvbs blindscan-dvbc xcore-mipsel"
OPENPLI_FEATURES_append += " ci kodi"
```

## conf/machine/osmini.conf
```bitbake
#@TYPE: Machine
#@NAME: Edision OS mini
#@DESCRIPTION: Machine configuration for the Edision OS mini

TARGET_ARCH = "mipsel"
DEFAULTTUNE = "mips32el"

require conf/machine/include/tune-mips32.inc

CHIPSET = "bcm7362"

PREFERRED_VERSION_linux-os = "4.3"

require conf/machine/include/os.inc

KERNEL_MODULE_AUTOLOAD += " \
	r8723bs \
	hci_uart \
	"

MACHINE_FEATURES += "textlcd blindscan-dvbs dvb-c blindscan-dvbc"

MACHINE_ESSENTIAL_EXTRA_RRECOMMENDS += " \
	kernel-module-hci-uart \
	"

MACHINE_EXTRA_RRECOMMENDS += " \
	firmware-rtl8723bs \
	bluez-hcitools \
	"

MACHINE_EXTRA_RDEPENDS += " \
	rtl8723bs \
	enigma2-plugin-drivers-dvb-usb-opticombo \
	enigma2-plugin-extensions-vfdcontrol \
	"
```

## conf/machine/osmini4k.conf
```bitbake
#@TYPE: Machine
#@NAME: Edision OS mini 4k
#@DESCRIPTION: Machine configuration for the Edision OS mini 4k

CHIPSET = "bcm72604"

require conf/machine/include/meta-edision.inc
require conf/machine/include/edision-arm64-common.inc
require conf/machine/include/edision-rootfs-emmc.inc

MACHINE_ESSENTIAL_EXTRA_RDEPENDS_append = " edision-dvb-modules-${MACHINE}"
MACHINE_ESSENTIAL_EXTRA_RRECOMMENDS_append = " resizerootfs"

DVBMEDIASINK_CONFIG = "--with-wma --with-pcm --with-dtsdownmix --with-eac3 --with-h265 --with-vb9"

PREFERRED_PROVIDER_virtual/blindscan-dvbs = "edision-blindscan-utils-${MACHINE}"
PREFERRED_PROVIDER_virtual/blindscan-dvbc = "edision-blindscan-utils-${MACHINE}"
PREFERRED_PROVIDER_virtual/kernel = "linux-edision"
PREFERRED_PROVIDER_virtual/egl = "libv3d-${MACHINE}"
PREFERRED_PROVIDER_virtual/libgles2 = "libv3d-${MACHINE}"

MTD_KERNEL = "mmcblk1p2"
KERNEL_CONSOLE = "ttyS0,115200n8"

MACHINE_FEATURES_append = " textlcd 7segment dvb-c blindscan-dvbs blindscan-dvbc v4l2m2m edision-cortexa15"
OPENPLI_FEATURES_append = " kodi openhbbtvbrowser"
```

## conf/machine/osminiplus.conf
```bitbake
#@TYPE: Machine
#@NAME: Edision OS mini+
#@DESCRIPTION: Machine configuration for the Edision OS mini+

CHIPSET = "bcm73625"

require conf/machine/include/bmips.inc
require conf/machine/include/build-extras.inc

MACHINE_ESSENTIAL_EXTRA_RDEPENDS += "os-dvb-modules-osminiplus"
MACHINE_ESSENTIAL_EXTRA_RDEPENDS += "rtl8723bs"
MACHINE_ESSENTIAL_EXTRA_RRECOMMENDS += "kernel-module-cdfs"
MACHINE_ESSENTIAL_EXTRA_RRECOMMENDS += "kernel-module-hci-uart"
MACHINE_ESSENTIAL_EXTRA_RRECOMMENDS += "kernel-module-rt2800usb"

MACHINE_EXTRA_RRECOMMENDS += "bluez-hcitools"
MACHINE_EXTRA_RRECOMMENDS += "enigma2-plugin-drivers-dvb-usb-opticombo"
MACHINE_EXTRA_RRECOMMENDS += "gst-plugin-dvbmediasink"

DVBMEDIASINK_CONFIG = "--with-wma --with-wmv --with-pcm --with-dts --with-eac3 --with-h265"

PREFERRED_PROVIDER_virtual/blindscan-dvbs = "os-blindscan-utils"
PREFERRED_PROVIDER_virtual/blindscan-dvbc = "os-blindscan-utils"

PREFERRED_PROVIDER_virtual/kernel = "linux-os"
PREFERRED_VERSION_linux-os = "4.7"

KERNEL_IMAGETYPE = "vmlinux"
KERNEL_OUTPUT = "${KERNEL_IMAGETYPE}"
KERNEL_OUTPUT_DIR = "."
MTD_KERNEL = "mtd1"
KERNEL_CONSOLE = "ttyS0,115200n8"

KERNEL_MODULE_AUTOLOAD += "r8723bs"
KERNEL_MODULE_AUTOLOAD += "hci_uart"

MACHINE_FEATURES += "alsa wlan 3dtv switchoff osdposition hdmicec"
MACHINE_FEATURES += "textlcd blindscan-dvbs dvb-c blindscan-dvbc"

require conf/machine/include/autoload-filesystems.inc
require conf/machine/include/rootfs-ubi.inc
```

## conf/machine/osmio4k.conf
```bitbake
#@TYPE: Machine
#@NAME: Edision OS mio 4k
#@DESCRIPTION: Machine configuration for the Edision OS mio 4k

CHIPSET = "bcm72604"

require conf/machine/include/brahma-b53.inc
require conf/machine/include/build-extras.inc

MACHINE_ESSENTIAL_EXTRA_RDEPENDS += "edision-dvb-modules-${MACHINE}"
MACHINE_ESSENTIAL_EXTRA_RDEPENDS += "wlan-qcacld-20"
MACHINE_ESSENTIAL_EXTRA_RRECOMMENDS += "kernel-module-cdfs"
MACHINE_ESSENTIAL_EXTRA_RRECOMMENDS += "kernel-module-hci-uart"
MACHINE_ESSENTIAL_EXTRA_RRECOMMENDS += "kernel-module-btqca"
MACHINE_ESSENTIAL_EXTRA_RRECOMMENDS += "kernel-module-rt2800usb"
MACHINE_ESSENTIAL_EXTRA_RRECOMMENDS += "firmware-qca6174"
MACHINE_ESSENTIAL_EXTRA_RRECOMMENDS += "wireless-regdb-static"
MACHINE_ESSENTIAL_EXTRA_RRECOMMENDS += "resizerootfs"

MACHINE_EXTRA_RRECOMMENDS += "enigma2-plugin-drivers-dvb-usb-opticombo"
MACHINE_EXTRA_RRECOMMENDS += "gst-plugin-dvbmediasink"
MACHINE_EXTRA_RRECOMMENDS += "edision-splash"

DVBMEDIASINK_CONFIG = "--with-wma --with-pcm --with-dtsdownmix --with-eac3 --with-h265 --with-vb9"

PREFERRED_VERSION_wireless-regdb = "2018.10.24"

PREFERRED_PROVIDER_virtual/blindscan-dvbs = "edision-blindscan-utils-${MACHINE}"
PREFERRED_PROVIDER_virtual/blindscan-dvbc = "edision-blindscan-utils-${MACHINE}"

PREFERRED_PROVIDER_virtual/kernel = "linux-edision"
PREFERRED_VERSION_linux-edision = "5.3"

PREFERRED_PROVIDER_virtual/egl = "libv3d-${MACHINE}"
PREFERRED_PROVIDER_virtual/libgles2 = "libv3d-${MACHINE}"

MTD_KERNEL = "mmcblk1p2"
KERNEL_IMAGETYPE = "Image.gz"
KERNEL_CONSOLE = "ttyS0,115200n8"

KERNEL_MODULE_AUTOLOAD += "wlan"
KERNEL_MODULE_AUTOLOAD += "hci_uart"

MACHINE_FEATURES += "alsa wlan 3dtv switchoff osdposition hdmicec textlcd dvb-c 7segment blindscan-dvbs blindscan-dvbc videoenhancement"

require conf/machine/include/autoload-filesystems.inc
require conf/machine/include/rootfs-emmc.inc
```

## conf/machine/osmio4kplus.conf
```bitbake
#@TYPE: Machine
#@NAME: Edision OS mio+ 4k
#@DESCRIPTION: Machine configuration for the Edision OS mio+ 4k

CHIPSET = "bcm72604"

require conf/machine/include/meta-edision.inc
require conf/machine/include/edision-arm64-common.inc
require conf/machine/include/edision-rootfs-emmc.inc

MACHINE_ESSENTIAL_EXTRA_RDEPENDS_append = " edision-dvb-modules-${MACHINE}"
MACHINE_ESSENTIAL_EXTRA_RRECOMMENDS_append = " kernel-module-qca6174 linux-firmware-qca6174"
MACHINE_ESSENTIAL_EXTRA_RRECOMMENDS_append = " kernel-module-hci-uart kernel-module-btqca"
MACHINE_ESSENTIAL_EXTRA_RRECOMMENDS_append = " wireless-regdb-static"
MACHINE_ESSENTIAL_EXTRA_RRECOMMENDS_append = " resizerootfs"

DVBMEDIASINK_CONFIG = "--with-wma --with-pcm --with-dtsdownmix --with-eac3 --with-h265 --with-vb9"

PREFERRED_PROVIDER_virtual/blindscan-dvbs = "edision-blindscan-utils-${MACHINE}"
PREFERRED_PROVIDER_virtual/blindscan-dvbc = "edision-blindscan-utils-${MACHINE}"
PREFERRED_PROVIDER_virtual/kernel = "linux-edision"
PREFERRED_PROVIDER_virtual/egl = "libv3d-${MACHINE}"
PREFERRED_PROVIDER_virtual/libgles2 = "libv3d-${MACHINE}"

MTD_KERNEL = "mmcblk1p2"
KERNEL_CONSOLE = "ttyS0,115200n8"

MACHINE_FEATURES_append = " dvb-c blindscan-dvbs blindscan-dvbc eglfs-brcmstb v4l2m2m edison-cortexa15"
OPENPLI_FEATURES_append = " kodi openhbbtvbrowser"

SET_QT_QPA_DEFAULT_PLATFORM = "eglfs"
SET_QT_QPA_EGLFS_INTEGRATION = "eglfs_brcmstb"
```

## conf/machine/osnino.conf
```bitbake
#@TYPE: Machine
#@NAME: Edision OS nino
#@DESCRIPTION: Machine configuration for the Edision OS nino

CHIPSET = "bcm7362"

require conf/machine/include/meta-edision.inc
require conf/machine/include/edision-mips-common.inc
require conf/machine/include/edision-rootfs-ubi.inc

MACHINE_ESSENTIAL_EXTRA_RDEPENDS_append = " os-dvb-modules-${MACHINE}"
MACHINE_ESSENTIAL_EXTRA_RRECOMMENDS_append = " kernel-module-8723bs linux-firmware-8723bs"
MACHINE_ESSENTIAL_EXTRA_RRECOMMENDS_append = " kernel-module-8723ds linux-firmware-8723ds"
MACHINE_ESSENTIAL_EXTRA_RRECOMMENDS_append = " kernel-module-hci-uart"
MACHINE_EXTRA_RRECOMMENDS_append = " rtk-hciattach"

DVBMEDIASINK_CONFIG = "--with-wma --with-wmv --with-pcm --with-dts --with-eac3"

PREFERRED_PROVIDER_virtual/kernel = "linux-os"
PREFERRED_VERSION_linux-os = "4.8.17"

MTD_KERNEL = "mtd2"
KERNEL_IMAGETYPE = "vmlinux.gz"
KERNEL_CONSOLE = "ttyS0,115200n8"

MACHINE_FEATURES_append = " textlcd 7segment dvb-c"
```
