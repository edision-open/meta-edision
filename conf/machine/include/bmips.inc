## conf/machine/osninopro.conf
```bitbake
#@TYPE: Machine
#@NAME: Edision OS nino pro
#@DESCRIPTION: Machine configuration for the Edision OS nino pro

CHIPSET = "bcm73625"

require conf/machine/include/bmips.inc
require conf/machine/include/build-extras.inc

MACHINE_ESSENTIAL_EXTRA_RDEPENDS += "os-dvb-modules-osninopro"
MACHINE_ESSENTIAL_EXTRA_RDEPENDS += "rtl8723bs"
MACHINE_ESSENTIAL_EXTRA_RRECOMMENDS += "kernel-module-cdfs"
MACHINE_ESSENTIAL_EXTRA_RRECOMMENDS += "kernel-module-hci-uart"
MACHINE_ESSENTIAL_EXTRA_RRECOMMENDS += "kernel-module-rt2800usb"

MACHINE_EXTRA_RRECOMMENDS += "enigma2-plugin-drivers-dvb-usb-opticombo"
MACHINE_EXTRA_RRECOMMENDS += "gst-plugin-dvbmediasink"
MACHINE_EXTRA_RRECOMMENDS += "edision-splash"

DVBMEDIASINK_CONFIG = "--with-wma --with-wmv --with-pcm --with-dts --with-eac3 --with-h265"

PREFERRED_PROVIDER_virtual/blindscan-dvbs = "edision-blindscan-utils-osninopro"
PREFERRED_PROVIDER_virtual/blindscan-dvbc = "edision-blindscan-utils-osninopro"

PREFERRED_PROVIDER_virtual/kernel = "linux-os"
PREFERRED_VERSION_linux-os = "4.8.17"

MTD_KERNEL = "mtd2"
KERNEL_IMAGETYPE = "vmlinux.gz"
KERNEL_CONSOLE = "ttyS0,115200n8"

KERNEL_MODULE_AUTOLOAD += "r8723bs"
KERNEL_MODULE_AUTOLOAD += "hci_uart"

MACHINE_FEATURES += "alsa wlan 3dtv switchoff osdposition hdmicec textlcd dvb-c 7segment blindscan-dvbs blindscan-dvbc videoenhancement"

require conf/machine/include/autoload-filesystems.inc
require conf/machine/include/edision-rootfs-ubi.inc
```
